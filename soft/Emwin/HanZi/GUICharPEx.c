/*
*********************************************************************************************************
*	                                  
*	模块名称 : 汉字显示接口
*	文件名称 : GUICharPEx.c
*	版    本 : V1.0
*	说    明 : 这种汉字显示方式适合使用等宽字体，非等宽的微软雅黑等字体显示效果较差。
*              支持点阵：
*                1. 支持12点阵，16点阵，24点阵以及32点阵汉字。
*                2. 6X12点阵的ASCII，8X16点阵的ASCII，12X24点阵的ASCII，16X32点阵的ASCII。
*              字库存储方式：
*                1. 字库存储到SPI FLASH里面。
*
*	修改记录 :
*		版本号    日期           作者         说明
*		V1.0    2015-04-24     Eric2013       首版
*
*      Copyright (C), 2015-2020, 安富莱电子 www.armfly.com
*
*********************************************************************************************************
*/
#include "MainTask.h"
//#include "GUI_Type.h"
#include "include.h"
//#include "sflash_spi.h"

#define  int  uint32_t 
const unsigned char emwin_asc2_2412[95][48];

/* 字模数据的暂存数组, 以单个字模的最大字节数为设定值 */ 
//#define BYTES_PER_FONT      512 
#define BYTES_PER_FONT      512 
static U8 GUI_FontDataBuf[BYTES_PER_FONT];

//exturn GUI_CONST_STORAGE GUI_FONT_PROP GUI_FontHZ16_PropHZ;
/*
*********************************************************************************************************
*	函 数 名: GUI_GetDataFromMemory
*	功能说明: 读取点阵数据
*	形    参: pProp  GUI_FONT_PROP类型结构
*             c      字符
*	返 回 值: 无
*********************************************************************************************************
*/
static void GUI_GetDataFromMemory(const GUI_FONT_PROP GUI_UNI_PTR *pProp, U16P c) 
{ 
    U16 BytesPerFont; 
    U32 oft, BaseAdd;
    char t;
	
//	char *font = (char *)pProp->paCharInfo->pData; 

	/* 每个字模的数据字节数 */
    BytesPerFont = GUI_pContext->pAFont->YSize * pProp->paCharInfo->BytesPerLine; 
    if (BytesPerFont > BYTES_PER_FONT)
  	{
	  	BytesPerFont = BYTES_PER_FONT;
	  }
		/* 英文字符地址偏移算法 */ 
//	  if(strncmp("H16", font, 3) == 0)  /* 16*16 字符 */
//		{
//			BaseAdd = 0x2000; //字库烧写入flash的地址
//		}
      BaseAdd = 0x2000;
      if(c < 0x80)
      {
          for(t=0;t<48;t++) GUI_FontDataBuf[t]=emwin_asc2_2412[c-0x20][t];
          return;
      }
      else
      {
//        if(font[21] == '1')
//        {
           oft = ((((c >> 8)-0xA1)) + ((c & 0xFF)-0xA1) * 94)* BytesPerFont + BaseAdd;
//        }
//        else
//        {
//            oft= ((((c >> 8)-0xA1)) + ((c & 0xFF)-0xB0) * 94) * BytesPerFont + BaseAdd;
//        }          
      }


		
		 
	/* 读取点阵数据 */
  sFLASH_NOR_Read(GUI_FontDataBuf, oft, BytesPerFont);
} 

/*
*********************************************************************************************************
*	函 数 名: GUIPROP_X_DispChar
*	功能说明: 显示字符
*	形    参: c 显示的字符
*	返 回 值: 无
*********************************************************************************************************
*/
void GUIPROP_X_DispChar(U16P c)  
{ 
    int BytesPerLine; 
    GUI_DRAWMODE DrawMode = GUI_pContext->TextMode; 
    const GUI_FONT_PROP GUI_UNI_PTR *pProp = GUI_pContext->pAFont->p.pProp; 
	
    /* 确定显示的字符是否在有效范围内 */  
    for (; pProp; pProp = pProp->pNext)                                          
    { 
        if ((c >= pProp->First) && (c <= pProp->Last))break; 
    } 
	
	/* 字符有效，进行显示 */
    if (pProp) 
    { 
        GUI_DRAWMODE OldDrawMode;
        const GUI_CHARINFO GUI_UNI_PTR * pCharInfo = pProp->paCharInfo;
        GUI_GetDataFromMemory(pProp, c);
        BytesPerLine = pCharInfo->BytesPerLine;                
        OldDrawMode  = LCD_SetDrawMode(DrawMode);
        LCD_DrawBitmap(GUI_pContext->DispPosX, GUI_pContext->DispPosY,
                       pCharInfo->XSize, GUI_pContext->pAFont->YSize,
                       GUI_pContext->pAFont->XMag, GUI_pContext->pAFont->YMag,
                       1,    
                       BytesPerLine,
                       &GUI_FontDataBuf[0],
                       &LCD_BKCOLORINDEX
                       );
		
        /* 填充背景 */
        if (GUI_pContext->pAFont->YDist > GUI_pContext->pAFont->YSize) 
        {
            int YMag = GUI_pContext->pAFont->YMag;
            int YDist = GUI_pContext->pAFont->YDist * YMag;
            int YSize = GUI_pContext->pAFont->YSize * YMag;
            if (DrawMode != LCD_DRAWMODE_TRANS) 
            {
                LCD_COLOR OldColor = GUI_GetColor();
                GUI_SetColor(GUI_GetBkColor());
                LCD_FillRect(GUI_pContext->DispPosX, GUI_pContext->DispPosY + YSize, 
                             GUI_pContext->DispPosX + pCharInfo->XSize, 
                             GUI_pContext->DispPosY + YDist);
                GUI_SetColor(OldColor);
            }
        }
		
        LCD_SetDrawMode(OldDrawMode);
//      if (!GUI_MoveRTL)
        GUI_pContext->DispPosX += pCharInfo->XDist * GUI_pContext->pAFont->XMag;
    }
} 

/*
*********************************************************************************************************
*	函 数 名: GUIPROP_X_GetCharDistX
*	功能说明: 获取字符的X轴间距
*	形    参: c  字符
*	返 回 值: 无
*********************************************************************************************************
*/
int GUIPROP_X_GetCharDistX(U16P c) 
{
    const GUI_FONT_PROP GUI_UNI_PTR * pProp = GUI_pContext->pAFont->p.pProp;  
    for (; pProp; pProp = pProp->pNext)                                         
    {
        if ((c >= pProp->First) && (c <= pProp->Last))break;
    }
    return (pProp) ? (pProp->paCharInfo)->XSize * GUI_pContext->pAFont->XMag : 0;
}

const unsigned char emwin_asc2_2412[95][48]={
{0x00,0x00,0x00,0x00,0x00,0x00,0x00,0x00,0x00,0x00,0x00,0x00,0x00,0x00,0x00,0x00,0x00,0x00,0x00,0x00,0x00,0x00,0x00,0x00,0x00,0x00,0x00,0x00,0x00,0x00,0x00,0x00,0x00,0x00,0x00,0x00,0x00,0x00,0x00,0x00,0x00,0x00,0x00,0x00,0x00,0x00,0x00,0x00},/*" ",0*/
{0x00,0x00,0x00,0x00,0x00,0x00,0x00,0x00,0x07,0x00,0x07,0x00,0x07,0x00,0x07,0x00,0x07,0x00,0x02,0x00,0x02,0x00,0x02,0x00,0x02,0x00,0x02,0x00,0x02,0x00,0x00,0x00,0x00,0x00,0x00,0x00,0x07,0x00,0x07,0x00,0x07,0x00,0x00,0x00,0x00,0x00,0x00,0x00},/*"!",1*/
{0x00,0x00,0x00,0x00,0x06,0x60,0x06,0x60,0x0C,0xC0,0x19,0x80,0x11,0x00,0x22,0x00,0x00,0x00,0x00,0x00,0x00,0x00,0x00,0x00,0x00,0x00,0x00,0x00,0x00,0x00,0x00,0x00,0x00,0x00,0x00,0x00,0x00,0x00,0x00,0x00,0x00,0x00,0x00,0x00,0x00,0x00,0x00,0x00},/*""",2*/
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{0x00,0x00,0x38,0x00,0x24,0x00,0x42,0x10,0x41,0x20,0x00,0xE0,0x00,0x00,0x00,0x00,0x00,0x00,0x00,0x00,0x00,0x00,0x00,0x00,0x00,0x00,0x00,0x00,0x00,0x00,0x00,0x00,0x00,0x00,0x00,0x00,0x00,0x00,0x00,0x00,0x00,0x00,0x00,0x00,0x00,0x00,0x00,0x00},/*"~",94*/
};
/***************************** 安富莱电子 www.armfly.com (END OF FILE) *********************************/
